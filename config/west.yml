## config/west.yml
```yaml
manifest:
  defaults:
    revision: main
  remotes:
    - name: zmkfirmware
      url-base: https://github.com/zmkfirmware
    - name: inverseTrig
      url-base: https://github.com/inverseTrig
  projects:
    - name: zmk
      remote: zmkfirmware
      import: app/west.yml
    - name: zmk-config
      remote: inverseTrig
      revision: main
      import: config/west.yml
  self:
    path: config
```
